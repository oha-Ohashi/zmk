## app/boards/shields/cly_lyntze/Kconfig.defconfig
```kconfig
# Copyright (c) 2022 The ZMK Contributors
# SPDX-License-Identifier: MIT

if SHIELD_CLY_LYNTZE

config ZMK_KEYBOARD_NAME
    default "Cly_Lyntze"

endif
```
